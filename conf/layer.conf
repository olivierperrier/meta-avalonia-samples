## conf/layer.conf
```bitbake
# We have a conf and classes directory, add to BBPATH
BBPATH .= ":${LAYERDIR}"

# We have recipes-* directories, add to BBFILES
BBFILES += "${LAYERDIR}/recipes-*/*/*.bb \
            ${LAYERDIR}/recipes-*/*/*.bbappend"

BBFILE_COLLECTIONS += "meta-avalonia-samples"
BBFILE_PATTERN_meta-avalonia-samples = "^${LAYERDIR}/"
BBFILE_PRIORITY_meta-avalonia-samples = "6"

LAYERDEPENDS_meta-avalonia-samples = "core"
LAYERSERIES_COMPAT_meta-avalonia-samples = "kirkstone  scarthgap"
```
